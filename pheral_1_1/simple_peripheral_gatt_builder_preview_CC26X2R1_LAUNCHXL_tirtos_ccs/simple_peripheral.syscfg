/**
 * @cliArgs --board "/ti/boards/CC26X2R1_LAUNCHXL" --product "simplelink_cc13x2_26x2_sdk@4.30.00.54"
 * @versions {"data":"2020090214","timestamp":"2020090214","tool":"1.6.0+1543","templates":"2020090214"}
 */

/**
 * Import the modules used in this configuration.
 */
const ble         = scripting.addModule("/ti/ble5stack/ble");
const CCFG        = scripting.addModule("/ti/devices/CCFG");
const rfdesign    = scripting.addModule("/ti/devices/radioconfig/rfdesign");
const Display     = scripting.addModule("/ti/display/Display");
const Display1    = Display.addInstance();
const AESCCM      = scripting.addModule("/ti/drivers/AESCCM");
const AESCCM1     = AESCCM.addInstance();
const AESCTRDRBG  = scripting.addModule("/ti/drivers/AESCTRDRBG");
const AESCTRDRBG1 = AESCTRDRBG.addInstance();
const AESECB      = scripting.addModule("/ti/drivers/AESECB");
const AESECB1     = AESECB.addInstance();
const ECDH        = scripting.addModule("/ti/drivers/ECDH");
const ECDH1       = ECDH.addInstance();
const GPIO        = scripting.addModule("/ti/drivers/GPIO");
const GPIO1       = GPIO.addInstance();
const GPIO2       = GPIO.addInstance();
const NVS         = scripting.addModule("/ti/drivers/NVS");
const NVS1        = NVS.addInstance();
const Power       = scripting.addModule("/ti/drivers/Power");
const RF          = scripting.addModule("/ti/drivers/RF");
const RTOS        = scripting.addModule("/ti/drivers/RTOS");
const TRNG        = scripting.addModule("/ti/drivers/TRNG");
const TRNG1       = TRNG.addInstance();

/**
 * Write custom configuration values to the imported modules.
 */
ble.lockProject                                           = true;
ble.enableGattBuilder                                     = true;
ble.gattBuilder                                           = true;
ble.radioConfig.codeExportConfig.$name                    = "ti_devices_radioconfig_code_export_param0";
ble.connUpdateParamsPeripheral.$name                      = "ti_ble5stack_general_ble_conn_update_params0";
ble.advSet1.$name                                         = "ti_ble5stack_broadcaster_advertisement_set0";
ble.advSet1.advParam1.$name                               = "ti_ble5stack_broadcaster_advertisement_params0";
ble.advSet1.advData1.$name                                = "ti_ble5stack_broadcaster_advertisement_data0";
ble.advSet1.advData1.GAP_ADTYPE_FLAGS                     = true;
ble.advSet1.advData1.advertisingFlags                     = ["GAP_ADTYPE_FLAGS_BREDR_NOT_SUPPORTED","GAP_ADTYPE_FLAGS_GENERAL"];
ble.advSet1.advData1.GAP_ADTYPE_LOCAL_NAME_SHORT          = true;
ble.advSet1.advData1.GAP_ADTYPE_16BIT_MORE                = true;
ble.advSet1.advData1.numOfUUIDs16More                     = 1;
ble.advSet1.advData1.UUID016More                          = 0xFFF0;
ble.advSet1.advData1.shortenedLocalName                   = "sp11";
ble.advSet1.scanRes1.$name                                = "ti_ble5stack_broadcaster_advertisement_data1";
ble.advSet1.scanRes1.GAP_ADTYPE_LOCAL_NAME_COMPLETE       = true;
ble.advSet1.scanRes1.completeLocalName                    = "Simple Peripheral";
ble.advSet1.scanRes1.GAP_ADTYPE_SLAVE_CONN_INTERVAL_RANGE = true;
ble.advSet1.scanRes1.maxConnInterval                      = 130;
ble.advSet1.scanRes1.GAP_ADTYPE_POWER_LEVEL               = true;
ble.advSet2.$name                                         = "ti_ble5stack_broadcaster_advertisement_set1";
ble.advSet2.advParam2.$name                               = "ti_ble5stack_broadcaster_advertisement_params1";
ble.advSet2.advParam2.advType                             = "extended";
ble.advSet2.advData2.$name                                = "ti_ble5stack_broadcaster_advertisement_data2";
ble.advSet2.advData2.GAP_ADTYPE_FLAGS                     = true;
ble.advSet2.advData2.advertisingFlags                     = ["GAP_ADTYPE_FLAGS_BREDR_NOT_SUPPORTED","GAP_ADTYPE_FLAGS_GENERAL"];
ble.advSet2.advData2.GAP_ADTYPE_LOCAL_NAME_SHORT          = true;
ble.advSet2.advData2.shortenedLocalName                   = "SP";
ble.advSet2.advData2.GAP_ADTYPE_16BIT_MORE                = true;
ble.advSet2.advData2.numOfUUIDs16More                     = 1;
ble.advSet2.advData2.UUID016More                          = 0xFFF0;
ble.advSet2.scanRes2.$name                                = "ti_ble5stack_broadcaster_advertisement_data3";
ble.advSet2.scanRes2.GAP_ADTYPE_LOCAL_NAME_COMPLETE       = true;
ble.advSet2.scanRes2.completeLocalName                    = "Simple Peripheral";
ble.advSet2.scanRes2.GAP_ADTYPE_SLAVE_CONN_INTERVAL_RANGE = true;
ble.advSet2.scanRes2.maxConnInterval                      = 130;
ble.advSet2.scanRes2.GAP_ADTYPE_POWER_LEVEL               = true;
ble.services.create(1);
ble.services[0].$name                                     = "Service_0";
ble.services[0].uuid                                      = 0xFFF0;
ble.services[0].userWriteCBfunc                           = "simpleProfile_WriteAttrCB";
ble.services[0].userReadCBfunc                            = "simpleProfile_ReadAttrCB";
ble.services[0].name                                      = "simpleProfile";
ble.services[0].characteristics.create(5);
ble.services[0].characteristics[0].$name                  = "Characteristic_0";
ble.services[0].characteristics[0].description            = "Characteristic 1";
ble.services[0].characteristics[0].properties             = ["GATT_PROP_READ","GATT_PROP_WRITE"];
ble.services[0].characteristics[0].name                   = "Char1";
ble.services[0].characteristics[0].permissions            = ["GATT_PERMIT_READ","GATT_PERMIT_WRITE"];
ble.services[0].characteristics[0].value                  = "1";
ble.services[0].characteristics[0].uuid                   = system.utils.bigInt("FFF1",16);
ble.services[0].characteristics[1].$name                  = "Characteristic_1";
ble.services[0].characteristics[1].description            = "Characteristic 2";
ble.services[0].characteristics[1].properties             = ["GATT_PROP_READ"];
ble.services[0].characteristics[1].name                   = "Char2";
ble.services[0].characteristics[1].permissions            = ["GATT_PERMIT_READ"];
ble.services[0].characteristics[1].value                  = "2";
ble.services[0].characteristics[1].uuid                   = system.utils.bigInt("FFF2",16);
ble.services[0].characteristics[2].$name                  = "Characteristic_2";
ble.services[0].characteristics[2].description            = "Characteristic 3";
ble.services[0].characteristics[2].name                   = "Char3";
ble.services[0].characteristics[2].permissions            = ["GATT_PERMIT_READ","GATT_PERMIT_WRITE"];
ble.services[0].characteristics[2].properties             = ["GATT_PROP_READ"];
ble.services[0].characteristics[2].value                  = "3";
ble.services[0].characteristics[2].uuid                   = system.utils.bigInt("FFF3",16);
ble.services[0].characteristics[3].$name                  = "Characteristic_3";
ble.services[0].characteristics[3].description            = "Characteristic 4";
ble.services[0].characteristics[3].properties             = ["GATT_PROP_NOTIFY"];
ble.services[0].characteristics[3].name                   = "Char4";
ble.services[0].characteristics[3].permissions            = ["GATT_PERMIT_READ","GATT_PERMIT_WRITE"];
ble.services[0].characteristics[3].value                  = "4";
ble.services[0].characteristics[3].uuid                   = system.utils.bigInt("FFF4",16);
ble.services[0].characteristics[4].$name                  = "Characteristic_4";
ble.services[0].characteristics[4].description            = "Characteristic 5";
ble.services[0].characteristics[4].name                   = "Char5";
ble.services[0].characteristics[4].bytes                  = 5;
ble.services[0].characteristics[4].properties             = ["GATT_PROP_READ"];
ble.services[0].characteristics[4].permissions            = ["GATT_PERMIT_READ"];
ble.services[0].characteristics[4].value                  = "1,2,3,4,5";
ble.services[0].characteristics[4].uuid                   = system.utils.bigInt("FFF5",16);

CCFG.enableBootloader         = true;
CCFG.enableBootloaderBackdoor = true;
CCFG.dioBootloaderBackdoor    = 13;
CCFG.levelBootloaderBackdoor  = "Active low";
CCFG.ccfgTemplate.$name       = "ti_devices_CCFGTemplate0";

Display1.$name                          = "CONFIG_Display_0";
Display1.$hardware                      = system.deviceData.board.components.XDS110UART;
Display1.enableANSI                     = true;
Display1.uartBufferSize                 = 128;
Display1.uart.$name                     = "CONFIG_DISPLAY_UART";
Display1.uart.txPinInstance.outputState = "High";
Display1.uart.txPinInstance.$name       = "CONFIG_PIN_UART_TX";
Display1.uart.rxPinInstance.$name       = "CONFIG_PIN_UART_RX";

AESCCM1.$name = "CONFIG_AESCCM0";

AESCTRDRBG1.$name              = "CONFIG_AESCTRDRBG_0";
AESCTRDRBG1.aesctrObject.$name = "CONFIG_AESCTR_0";

AESECB1.$name = "CONFIG_AESECB0";

ECDH1.$name = "CONFIG_ECDH0";

GPIO1.$hardware         = system.deviceData.board.components["BTN-1"];
GPIO1.mode              = "Dynamic";
GPIO1.$name             = "CONFIG_GPIO_BTN1";
GPIO1.pinInstance.$name = "CONFIG_PIN_BTN1";

GPIO2.$hardware         = system.deviceData.board.components["BTN-2"];
GPIO2.mode              = "Dynamic";
GPIO2.$name             = "CONFIG_GPIO_BTN2";
GPIO2.pinInstance.$name = "CONFIG_PIN_BTN2";

NVS1.$name                    = "CONFIG_NVSINTERNAL";
NVS1.internalFlash.$name      = "ti_drivers_nvs_NVSCC26XX0";
NVS1.internalFlash.regionBase = 0x48000;
NVS1.internalFlash.regionSize = 0x4000;

TRNG1.$name = "CONFIG_TRNG_0";

/**
 * Pinmux solution for unlocked pins/peripherals. This ensures that minor changes to the automatic solver in a future
 * version of the tool will not impact the pinmux you originally saw.  These lines can be completely deleted in order to
 * re-solve from scratch.
 */
Display1.uart.uart.$suggestSolution       = "UART1";
Display1.uart.uart.txPin.$suggestSolution = "boosterpack.4";
Display1.uart.uart.rxPin.$suggestSolution = "boosterpack.3";
GPIO1.gpioPin.$suggestSolution            = "boosterpack.13";
GPIO2.gpioPin.$suggestSolution            = "boosterpack.12";
