/**
 * @cliArgs --board "/ti/boards/CC26X2R1_LAUNCHXL" --product "simplelink_cc13x2_26x2_sdk@4.30.00.54"
 * @versions {"data":"2020090214","timestamp":"2020090214","tool":"1.6.0+1543","templates":"2020090214"}
 */

/**
 * Import the modules used in this configuration.
 */
const GPIO  = scripting.addModule("/ti/drivers/GPIO");
const GPIO1 = GPIO.addInstance();
const GPIO2 = GPIO.addInstance();
const GPIO3 = GPIO.addInstance();
const GPIO4 = GPIO.addInstance();
const GPIO5 = GPIO.addInstance();
const RTOS  = scripting.addModule("/ti/drivers/RTOS");

/**
 * Write custom configuration values to the imported modules.
 */
GPIO1.$hardware         = system.deviceData.board.components["BTN-1"];
GPIO1.mode              = "Dynamic";
GPIO1.$name             = "CONFIG_GPIO_BUTTON_0";
GPIO1.pinInstance.$name = "CONFIG_PIN_0";

GPIO2.$hardware         = system.deviceData.board.components["BTN-2"];
GPIO2.mode              = "Dynamic";
GPIO2.$name             = "CONFIG_GPIO_BUTTON_1";
GPIO2.pinInstance.$name = "CONFIG_PIN_1";

GPIO3.$hardware         = system.deviceData.board.components.LED_RED;
GPIO3.$name             = "CONFIG_GPIO_LED_0";
GPIO3.pinInstance.$name = "CONFIG_PIN_2";

GPIO4.$hardware         = system.deviceData.board.components.LED_GREEN;
GPIO4.$name             = "CONFIG_GPIO_LED_1";
GPIO4.pinInstance.$name = "CONFIG_PIN_3";

GPIO5.$name             = "CONFIG_GPIO_0";
GPIO5.gpioPin.$assign   = "boosterpack.31";
GPIO5.pinInstance.$name = "CONFIG_PIN_4";

const CCFG              = scripting.addModule("/ti/devices/CCFG", {}, false);
CCFG.ccfgTemplate.$name = "ti_devices_CCFGTemplate0";

RTOS.name = "FreeRTOS";

/**
 * Pinmux solution for unlocked pins/peripherals. This ensures that minor changes to the automatic solver in a future
 * version of the tool will not impact the pinmux you originally saw.  These lines can be completely deleted in order to
 * re-solve from scratch.
 */
GPIO1.gpioPin.$suggestSolution = "boosterpack.13";
GPIO2.gpioPin.$suggestSolution = "boosterpack.12";
GPIO3.gpioPin.$suggestSolution = "boosterpack.39";
GPIO4.gpioPin.$suggestSolution = "boosterpack.40";
