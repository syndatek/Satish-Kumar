/**
 * @cliArgs --board "/ti/boards/CC26X2R1_LAUNCHXL" --product "simplelink_cc13x2_26x2_sdk@4.30.00.54"
 * @versions {"data":"2020090214","timestamp":"2020090214","tool":"1.6.0+1543","templates":"2020090214"}
 */

/**
 * Import the modules used in this configuration.
 */
const Display  = scripting.addModule("/ti/display/Display");
const Display1 = Display.addInstance();
const ADC      = scripting.addModule("/ti/drivers/ADC");
const ADC1     = ADC.addInstance();
const ADC2     = ADC.addInstance();
const RTOS     = scripting.addModule("/ti/drivers/RTOS");

/**
 * Write custom configuration values to the imported modules.
 */
Display1.$name                    = "CONFIG_Display_0";
Display1.$hardware                = system.deviceData.board.components.XDS110UART;
Display1.uart.$name               = "CONFIG_UART_0";
Display1.uart.txPinInstance.$name = "CONFIG_PIN_2";
Display1.uart.rxPinInstance.$name = "CONFIG_PIN_3";

ADC1.$name                = "CONFIG_ADC_0";
ADC1.adc.adcPin.$assign   = "boosterpack.24";
ADC1.adcPinInstance.$name = "CONFIG_PIN_0";

ADC2.$name                = "CONFIG_ADC_1";
ADC2.adc.adcPin.$assign   = "boosterpack.6";
ADC2.adcPinInstance.$name = "CONFIG_PIN_1";

const CCFG              = scripting.addModule("/ti/devices/CCFG", {}, false);
CCFG.ccfgTemplate.$name = "ti_devices_CCFGTemplate0";

/**
 * Pinmux solution for unlocked pins/peripherals. This ensures that minor changes to the automatic solver in a future
 * version of the tool will not impact the pinmux you originally saw.  These lines can be completely deleted in order to
 * re-solve from scratch.
 */
Display1.uart.uart.$suggestSolution       = "UART0";
Display1.uart.uart.txPin.$suggestSolution = "boosterpack.4";
Display1.uart.uart.rxPin.$suggestSolution = "boosterpack.3";
ADC1.adc.$suggestSolution                 = "ADC0";
ADC2.adc.$suggestSolution                 = "ADC0";
